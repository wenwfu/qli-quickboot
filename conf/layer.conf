## conf/layer.conf
```bitbake
# We have a conf and classes directory, add to BBPATH
BBPATH .= ":${LAYERDIR}"

# We have recipes-* directories, add to BBFILES
BBFILES += "${LAYERDIR}/recipes-*/*/*.bb \
            ${LAYERDIR}/recipes-*/*/*.bbappend"

BBFILE_COLLECTIONS += "qli-quickboot"
BBFILE_PATTERN_qli-quickboot = "^${LAYERDIR}/"
BBFILE_PRIORITY_qli-quickboot = "7"

LAYERDEPENDS_qli-quickboot = "core"
LAYERSERIES_COMPAT_qli-quickboot = "scarthgap styhead walnascar"
```
